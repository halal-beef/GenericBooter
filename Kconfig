## Kconfig
```kconfig
#
# For a description of the syntax of this configuration file,
# see scripts/config-language.txt.
#
mainmenu "GenericBooter/$ARCH Configuration"

choice
	prompt "ARM processor target"
	default PROC_CORTEX_A8

config PROC_CORTEX_A15
	bool "Cortex-A15"

config PROC_CORTEX_A9
	bool "Cortex-A9"

config PROC_CORTEX_A8
	bool "Cortex-A8"

config PROC_CORTEX_A7
	bool "Cortex-A7"

config PROC_ARM1176JZFS
	bool "ARM1176JZF-S"

endchoice

choice
	prompt "ARM board target"
	default BOARD_ARM_REALVIEW

config BOARD_ARM_REALVIEW
	bool "ARM RealView"

config BOARD_HPTOUCHPAD
	bool "HP TouchPad"
	depends on PROC_CORTEX_A9

config BOARD_HTC_HD2
	bool "HTC HD2"
	depends on PROC_CORTEX_A8

config BOARD_OMAP54XX
	bool "Texas Instruments OMAP54XX"
	depends on PROC_CORTEX_A9

config BOARD_OMAP34XX
	bool "Texas Instruments OMAP3XXX"
	depends on PROC_CORTEX_A8

config BOARD_AM335X
	bool "Texas Instruments AM335X"
	depends on PROC_CORTEX_A8

config BOARD_BCM2836
	bool "Broadcom BCM2836"
	depends on PROC_CORTEX_A7

config BOARD_IMX53_USBARMORY
	bool "Inverse Path USB armory MkI"
	depends on PROC_CORTEX_A8

config BOARD_SAMSUNG_JF
	bool "Samsung Galaxy S4"
	depends on PROC_CORTEX_A15

endchoice

choice
	prompt "Device tree style"
	default DT_SUPPORT_APPLE_FDT

config DT_SUPPORT_APPLE_FDT
	bool "iOS-compatible flattened device tree"

config DT_SUPPORT_XML
	bool "XML device tree"

endchoice
```
